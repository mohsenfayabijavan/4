/**
programer  Mohsen Faryabi
date       1397/9/4
Co         Javan electronic jiroft
instagram  Javan_electronic_jiroft
tel        09134484899


 */
 


//------------------------------------------------------------
//-------------------copy to main------------------------------
//I2C_HandleTypeDef read_i2c_in_main (void) {return hi2c1;}
//#include "ds1331.h"


//------------------------------------------------------------
//------------------------------------------------------------
//------------------------------------------------------------
//------------------------------------------------------------
//------------------------------------------------------------
//------------------------------------------------------------
//------------------------------------------------------------
//------------------------------------------------------------
//------------------------------------------------------------
//------------------------------------------------------------
//------------------------------------------------------------
//------------------------------------------------------------

// I2C slave address for DS1331
#define DS1331_I2C_ADDR				0xD0

/* Registers location */
#define DS1331_SECONDS				0x00
#define DS1331_MINUTES				0x01
#define DS1331_HOURS			  	0x02
#define DS1331_DAY					  0x03
#define DS1331_DATE					  0x04
#define DS1331_MONTH				  0x05
#define DS1331_YEAR					  0x06
#define DS1331_CONTROL				0x07

// Bits in control register
//#define DS1307_CONTROL_OUT			7
//#define DS1307_CONTROL_SQWE			4
//#define DS1307_CONTROL_RS1			1
//#define DS1307_CONTROL_RS0			0

enum {
	GET_ALL =100,
	GET_YEAR    ,
	GET_MONT    ,
	GET_DAY_WEEK,
	GET_DAY_MONT,
	GET_HOUR    ,
	GET_MIN     ,
	GET_SEC     ,
	
	SET_ALL     ,
	SET_YEAR    ,
	SET_MONT    ,
	SET_DAY_WEEK,
	SET_DAY_MONT,
	SET_HOUR    ,
	SET_MIN     ,
	SET_SEC     , 
  NOT_SENT_VAR,	
};



  class DS1331{
	
	public:
		char data_dump[10];
	  char mont,day_of_week,day_of_mont,hour,min,sec,sec_temp;
	  int year;
	
	  bool get_time(char select=GET_ALL);
	  bool set_time(char select=SET_ALL ,int data = NOT_SENT_VAR);
	  bool set_time(int,char,char,char,char,char);
	
	
	
	
	
	
	private:
		char BCD2DEC(char data){return (data>>4)*10+(data&0x0F);}
    char DEC2BCD (char data){	return (data/10)<<4|(data%10);}
		bool send_i2c(char rigester , int data);
		
		
		
		
		
	
	}rtc;
//------------------------------------------------------
//------------------------------------------------------
//------------------------------------------------------
	bool DS1331::get_time(char select)
	{	
		//char data_dump[8];
		I2C_HandleTypeDef i2c=read_i2c_in_main();
		
		if(select ==GET_ALL)
    {
			data_dump[0]=0x00;
      HAL_I2C_Master_Transmit(&i2c,DS1331_I2C_ADDR,(uint8_t*)data_dump,1,100);
		  HAL_I2C_Master_Receive (&i2c,DS1331_I2C_ADDR,(uint8_t*)data_dump,7,100);
			
		  sec=           BCD2DEC(data_dump[0]);
		  min=           BCD2DEC(data_dump[1]);
		  hour=          BCD2DEC(data_dump[2]);
		  day_of_week =  BCD2DEC(data_dump[3]);
		  day_of_mont=   BCD2DEC(data_dump[4]);
		  mont=          BCD2DEC(data_dump[5]);
	  	year=          BCD2DEC(data_dump[6]);
		}
		if(select ==GET_YEAR)
    {
		}
		if(select ==GET_MONT)
    {
		}
		if(select ==GET_DAY_WEEK)
    {
		}
		if(select ==GET_DAY_MONT)
    {
		}
		if(select ==GET_HOUR)
    {
		}
		if(select ==GET_MIN)
    {
		}
		if(select ==GET_SEC)
    {
		}
			

		
	 	 return 0;
	}
	
//------------------------------------------------------
//------------------------------------------------------
//------------------------------------------------------
bool DS1331::set_time(char select ,int data)
	{	
		//char data_dump[10];
		I2C_HandleTypeDef i2c=read_i2c_in_main();
		
		if(year >=1900) year-=1990;
		if(year >=2000) year-=2000;
		
		if(select == SET_ALL)
		{
			data_dump[0] = 0; // to set all
			
			data_dump[1]  = DEC2BCD(sec);
			data_dump[2]  = DEC2BCD(min);
			data_dump[3]  = DEC2BCD(hour);
			data_dump[4]  = DEC2BCD(day_of_week);
			data_dump[5]  = DEC2BCD(day_of_mont);
			data_dump[6]  = DEC2BCD(mont);
			data_dump[7]  = DEC2BCD(year);
			
		  HAL_I2C_Master_Transmit(&i2c,DS1331_I2C_ADDR,(uint8_t*)data_dump,8,100);	
		}
		
	if(data != NOT_SENT_VAR)
	{		
	  if(select == SET_SEC 	    ) send_i2c(DS1331_SECONDS , data);
		if(select == SET_MIN      ) send_i2c(DS1331_MINUTES , data);
		if(select == SET_HOUR     ) send_i2c(DS1331_HOURS   , data);
		if(select == SET_DAY_WEEK ) send_i2c(DS1331_DAY     , data);
		if(select == SET_DAY_MONT ) send_i2c(DS1331_DATE    , data);
		if(select == SET_MONT     ) send_i2c(DS1331_MONTH   , data);
		if(select == SET_YEAR     ) send_i2c(DS1331_YEAR    , data);
		else return 0;
	}
	 	 return 0;
	}
//------------------------------------------------------
//------------------------------------------------------
//------------------------------------------------------
	bool DS1331::set_time(int year ,char mont , char day_of_mont ,char hour,char min,char sec=0)
	{	
		//char data_dump[10];
		I2C_HandleTypeDef i2c=read_i2c_in_main();
		
		//if(year >=1900) year-=1990;
		if(year >=2000) year-=2000;
		
			data_dump[0] = 0; // to set all
			
			data_dump[1]  = DEC2BCD(sec);
			data_dump[2]  = DEC2BCD(min);
			data_dump[3]  = DEC2BCD(hour);
			data_dump[4]  = DEC2BCD(day_of_week);
			data_dump[5]  = DEC2BCD(day_of_mont);
			data_dump[6]  = DEC2BCD(mont);
			data_dump[7]  = DEC2BCD(year);
			
		  HAL_I2C_Master_Transmit(&i2c,DS1331_I2C_ADDR,(uint8_t*)data_dump,8,100);	
		
	
	 	 return 0;
	}
//------------------------------------------------------
//------------------------------------------------------
//------------------------------------------------------
	bool DS1331::send_i2c(char rigester , int data)
	{
		//char data_dump[2];
		I2C_HandleTypeDef i2c=read_i2c_in_main();
		
		if(rigester == DS1331_SECONDS){if(data > 59 ) return 0;} 
    if(rigester == DS1331_MINUTES){if(data > 59 ) return 0;} 
		if(rigester == DS1331_HOURS  ){if(data > 23 ) return 0;} 
		if(rigester == DS1331_DAY    ){if(data > 7 )  return 0;} 
		if(rigester == DS1331_DATE   ){if(data > 31 ) return 0;}
		if(rigester == DS1331_MONTH  ){if(data > 12 ) return 0;}
		if(rigester == DS1331_DATE   ){if(data > 31 ) return 0;}
		if(rigester == DS1331_YEAR   ){if(data > 2000) data-=2000;}
		 
		data_dump[0] = rigester;
		data_dump[1] = DEC2BCD(data);
		HAL_I2C_Master_Transmit(&i2c,DS1331_I2C_ADDR,(uint8_t*)data_dump,2,100);
		
		return 1;
	}
//------------------------------------------------------
//------------------------------------------------------
//------------------------------------------------------

//------------------------------------------------------
//------------------------------------------------------
//------------------------------------------------------

//------------------------------------------------------
//------------------------------------------------------
//------------------------------------------------------

//------------------------------------------------------
//------------------------------------------------------
//------------------------------------------------------

//------------------------------------------------------
//------------------------------------------------------
//------------------------------------------------------

//------------------------------------------------------
//------------------------------------------------------
//------------------------------------------------------

//------------------------------------------------------
//------------------------------------------------------
//------------------------------------------------------

//------------------------------------------------------
//------------------------------------------------------
//------------------------------------------------------

//------------------------------------------------------
//------------------------------------------------------
//------------------------------------------------------

//------------------------------------------------------
//------------------------------------------------------
//------------------------------------------------------

//------------------------------------------------------
//------------------------------------------------------
//------------------------------------------------------

//------------------------------------------------------
//------------------------------------------------------
//------------------------------------------------------

//------------------------------------------------------
//------------------------------------------------------
//------------------------------------------------------

//------------------------------------------------------
//------------------------------------------------------
//------------------------------------------------------

//------------------------------------------------------
//------------------------------------------------------
//------------------------------------------------------

//------------------------------------------------------
//------------------------------------------------------
//------------------------------------------------------

//------------------------------------------------------
//------------------------------------------------------
//------------------------------------------------------

//------------------------------------------------------
//------------------------------------------------------
//------------------------------------------------------

//------------------------------------------------------
//------------------------------------------------------
//------------------------------------------------------

//------------------------------------------------------
//------------------------------------------------------
//------------------------------------------------------

